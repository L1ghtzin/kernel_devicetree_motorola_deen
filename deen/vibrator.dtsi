&pmi_haptic{
	qcom,actuator-type = <1>;
	qcom,lra-auto-res-mode="none";
	qcom,wave-shape = "sine";
	qcom,lra-high-z="opt1";
	qcom,lra-res-cal-period = <4>;
	/* period below corresponds to 175 Hz */
	qcom,wave-play-rate-us = <5714>;
	qcom,vmax-mv = <2900>;
	qcom,vmax-low-mv = <1160>;
	qcom,context-haptics;
	qcom,brake-pattern = [03 03 02 00];
	qcom,misc-trim-error-rc19p2-clk-reg-present;
};

&pmi_haptic {
	qcom,lra-auto-res-mode="qwd";
	qcom,lra-high-z="opt1";
	qcom,lra-res-cal-period = <0>;
	qcom,wave-play-rate-us = <4878>;
	qcom,vmax-mv = <2600>;
	qcom,vmax-low-mv = <2600>;
	qcom,ilim-ma = <100>;
	qcom,brake-pattern = [03 03 03 00];
};
