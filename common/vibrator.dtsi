&pmi_haptic{
	qcom,actuator-type = "lra";
	qcom,lra-auto-res-mode="none";
	qcom,wave-shape = "sine";
	qcom,lra-high-z="opt1";
	qcom,lra-res-cal-period = <4>;
	/* period below corresponds to 175 Hz */
	qcom,wave-play-rate-us = <5714>;
	qcom,vmax-mv = <2900>;
	qcom,vmax-low-mv = <1160>;
	qcom,context-haptics;
	qcom,brake-pattern = [03 03 02 00];
	qcom,misc-trim-error-rc19p2-clk-reg-present;
};
