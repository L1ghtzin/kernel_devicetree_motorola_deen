&soc {
	stmvl53l0@29 {
	compatible = "st,stmvl53l0_i2c";
	reg = <0x29>;
	vdd-supply = <&pm8950_l22>;
	gpios = <&tlmm 86 0>, <&tlmm 43 0>;
	qcom,gpio-reset = <0>;
	qcom,gpio-req-tbl-num = <0 1>;
	qcom,gpio-req-tbl-flags = <0 1>;
	qcom,gpio-req-tbl-label ="TOF_XSHUTDOWN","TOF_INT";
	pinctrl-names = "laser_default", "laser_suspend";
	pinctrl-0 = <&laser_active >;
	pinctrl-1 = <&laser_suspend >;
	st,sensorthreshold = <60 65>;
	st,xtalkval = <19>;
};
