&soc {
		fpc_fpc1020@0{
			compatible = "fpc,fpc1020";
			status = "ok";
			reg = <0>;
			interrupts = <42 0x0>;
			spi-max-frequency = <4800000>;
			fpc,gpio_irq = <&tlmm 42 0>;
			fpc,gpio_rst = <&tlmm 47 0>;
			fpc,txout_boost_enable;
			vcc_spi-supply = <&pm8953_s3>;
			vcc_ana-supply = <&pm8953_l6>;
			vcc_io-supply  = <&pm8953_l6>;
			clock-names = "iface_clk", "core_clk";
			clocks = <&clock_gcc clk_gcc_blsp2_ahb_clk>,
			<&clock_gcc clk_gcc_blsp2_qup4_spi_apps_clk>;
		};
};
