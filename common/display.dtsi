#include "dsi-panel/dsi-panel-mot-dummy-qhd-video.dtsi"

&mdss_dsi_active {
	config {
		/delete-property/ output-high;
	};
};

&mdss_mdp {
	qcom,mdss-pref-prim-intf = "dsi";
};

&mdss_dsi0 {
	qcom,display-id = "primary";
};
